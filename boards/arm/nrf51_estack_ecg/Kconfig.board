## boards/arm/nrf51_estack_ecg/Kconfig.board
```kconfig
# Kconfig - nRF51 ESTACK_ECG board configuration
#
# Copyright (c) 2016 Linaro Limited.
#
# SPDX-License-Identifier: Apache-2.0

config BOARD_NRF51_ESTACK_ECG
	bool "nRF51 ESTACK_ECG"
	depends on SOC_NRF51822_QFAC
```

## boards/arm/nrf51_estack_ecg/Kconfig.defconfig
```kconfig
# Kconfig - nRF51 ESTACK_ECG board configuration
#
# Copyright (c) 2016 Linaro Limited.
#
# SPDX-License-Identifier: Apache-2.0

if BOARD_NRF51_ESTACK_ECG

config BOARD
	default "nrf51_estack_ecg"

if GPIO_NRF5

config GPIO_NRF5_P0
	default y

endif # GPIO_NRF5

if UART_NRFX

config UART_0_NRF_TX_PIN
	default 16

config UART_0_NRF_RX_PIN
	default 12

#config UART_0_NRF_RTS_PIN
#	default 8

#config UART_0_NRF_CTS_PIN
#	default 10

endif # UART_NRFX

if I2C

config I2C_NRFX
	def_bool y

if I2C_NRFX

config I2C_0
	def_bool y

endif #I2C_NRFX

if I2C_0

choice I2C_0_NRF_TYPE
	default I2C_0_NRF_TWI

endchoice

endif # I2C_0

endif # I2C

if SPI

config SPI_1
	def_bool y

config SPI_1_NAME
	default "SPI_1"

config SPI_1_OP_MODES
	default 1

config SPI_1_IRQ_PRI
	default 1

config SPI_INIT_PRIORITY
	default 70

config SPI_NRFX
	def_bool y

#choice SPI_1_NRF_TYPE
#	default SPI_1_NRF_SPI

#endchoice

config SPI_1_NRF_SCK_PIN
	default 29

config SPI_1_NRF_MOSI_PIN
	default 25

config SPI_1_NRF_MISO_PIN
	default 28

config SPI_1_NRF_ORC
	default 0xff

endif # SPI

endif # BOARD_NRF51_ESTACK_ECG
```

## boards/arm/nrf51_estack_ecg/nrf51_estack_ecg_defconfig
```kconfig
CONFIG_ARM=y
CONFIG_SOC_FAMILY_NRF=y
CONFIG_SOC_SERIES_NRF51X=y
CONFIG_SOC_NRF51822_QFAC=y
CONFIG_BOARD_NRF51_ESTACK_ECG=y

# enable uart driver
CONFIG_SERIAL=y
CONFIG_UART_NRFX=y
CONFIG_UART_0_NRF_UART=y

# enable console
CONFIG_CONSOLE=y
CONFIG_UART_CONSOLE=y

# enable spi
CONFIG_SPI=y
CONFIG_SPI_1_NRF_SPI=y
# enable i2c
CONFIG_I2C=y

# bluetooth
CONFIG_BT=y
CONFIG_BT_CTLR=y

CONFIG_SENSOR=y
CONFIG_SENSOR_INIT_PRIORITY=90

#
# Device Drivers
#
# CONFIG_ADXL362 is not set
# CONFIG_AK8975 is not set
# CONFIG_AMG88XX is not set
# CONFIG_APDS9960 is not set
# CONFIG_BMA280 is not set
# CONFIG_BMC150_MAGN is not set
# CONFIG_BME280 is not set
# CONFIG_BMG160 is not set
# CONFIG_BMI160 is not set
# CONFIG_BMM150 is not set
# CONFIG_CCS811 is not set
# CONFIG_DHT is not set
# CONFIG_FXAS21002 is not set
# CONFIG_FXOS8700 is not set
# CONFIG_HDC1008 is not set
# CONFIG_HMC5883L is not set
# CONFIG_HP206C is not set
# CONFIG_HTS221 is not set
CONFIG_MAX30205=y
CONFIG_MAX30205_NAME="MAX30205"
CONFIG_MAX30205_I2C_MASTER_DEV_NAME="I2C_0"
CONFIG_MAX30205_TRIGGER_NONE=y
# CONFIG_MAX30205_TRIGGER_GLOBAL_THREAD is not set
# CONFIG_MAX30205_TRIGGER_OWN_THREAD is not set
CONFIG_MAX30205_ODR="1"
# CONFIG_ISL29035 is not set
# CONFIG_LIS2DH is not set
# CONFIG_LIS3DH is not set
# CONFIG_LIS3MDL is not set
# CONFIG_LPS22HB is not set
# CONFIG_LPS25HB is not set
# CONFIG_LSM6DS0 is not set
# CONFIG_LSM6DSL is not set
# CONFIG_LSM9DS0_GYRO is not set
# CONFIG_LSM9DS0_MFD is not set
# CONFIG_MAX30101 is not set
# CONFIG_MAX44009 is not set
# CONFIG_MCP9808 is not set
CONFIG_MPU6050=y
CONFIG_MPU6050_NAME="MPU6050"
CONFIG_MPU6050_I2C_ADDR=0x68
CONFIG_MPU6050_I2C_MASTER_DEV_NAME="I2C_0"
CONFIG_MPU6050_TRIGGER_NONE=y
# CONFIG_MPU6050_TRIGGER_GLOBAL_THREAD is not set
# CONFIG_MPU6050_TRIGGER_OWN_THREAD is not set
CONFIG_MPU6050_ACCEL_FS=2
CONFIG_MPU6050_GYRO_FS=250
CONFIG_TEMP_NRF5=y
CONFIG_TEMP_NRF5_NAME="TEMP_0"
CONFIG_TEMP_NRF5_PRI=1
# CONFIG_PMS7003 is not set
# CONFIG_SHT3XD is not set
# CONFIG_SX9500 is not set
# CONFIG_TH02 is not set
# CONFIG_TMP007 is not set
# CONFIG_TMP112 is not set
# CONFIG_VL53L0X is not set
```

## boards/arm/nrf51_estack_tgam/Kconfig.board
```kconfig
# Kconfig - nRF51 ESTACK_TGAM board configuration
#
# Copyright (c) 2016 Linaro Limited.
#
# SPDX-License-Identifier: Apache-2.0

config BOARD_NRF51_ESTACK_TGAM
	bool "nRF51 ESTACK_TGAM"
	select HAS_DTS_I2C
	depends on SOC_NRF51822_QFAC
```

## boards/arm/nrf51_estack_tgam/nrf51_estack_tgam_defconfig
```kconfig
CONFIG_ARM=y
CONFIG_SOC_FAMILY_NRF=y
CONFIG_SOC_SERIES_NRF51X=y
CONFIG_SOC_NRF51822_QFAC=y
CONFIG_BOARD_NRF51_ESTACK_TGAM=y

# enable uart driver
CONFIG_SERIAL=y
CONFIG_UART_NRFX=y
CONFIG_UART_0_NRF_UART=y

# enable console
# CONFIG_CONSOLE=y
# CONFIG_UART_CONSOLE=y

# bluetooth
CONFIG_BT=y
CONFIG_BT_CTLR=y

CONFIG_HAS_HW_NRF_ADC=y
CONFIG_NRFX_ADC=y
CONFIG_ADC_NRFX_ADC=y
CONFIG_ADC_NRFX_ADC_CHANNEL_COUNT=3
CONFIG_ADC=y
CONFIG_ADC_0=y
CONFIG_HAS_DTS_ADC=y
```

## drivers/sensor/ads1x9x/Kconfig
```kconfig
# Kconfig - Bosch ADS1X9X inertial measurement configuration options

#
# Copyright (c) 2016 Intel Corporation
#
# SPDX-License-Identifier: Apache-2.0
#

menuconfig ADS1X9X
	bool "ADS1X9X inertial measurement unit"
	depends on SPI
	help
	  Enable ADS1X9X inertial measurement unit that provides ecg
	  and angular rate measurements.

config ADS1X9X_NAME
	string "Driver's name"
	depends on ADS1X9X
	default "ADS1X9X"

config ADS1X9X_SPI_PORT_NAME
	string "SPI master controller port name"
	depends on ADS1X9X
	default "SPI_1"
	help
	  Master SPI port name through which ADS1X9X chip is accessed.

config ADS1X9X_SLAVE
	int "ADS1X9X SPI slave select pin"
	depends on ADS1X9X
	default 24
	help
	  ADS1X9X chip select pin.

config ADS1X9X_SPI_BUS_FREQ
	int "ADS1X9X SPI bus speed in Hz"
	default 640000
	depends on ADS1X9X
	help
	  This is the maximum supported SPI bus frequency. The chip supports a
	  frequency up to 10MHz.

choice
	prompt "Trigger mode"
	depends on ADS1X9X
	default ADS1X9X_TRIGGER_GLOBAL_THREAD
	help
	  Specify the type of triggering to be used by the driver.

config ADS1X9X_TRIGGER_NONE
	bool
	prompt "No trigger"

config ADS1X9X_TRIGGER_GLOBAL_THREAD
	bool "Use global thread"
	select ADS1X9X_TRIGGER

config ADS1X9X_TRIGGER_OWN_THREAD
	bool "Use own thread"
	select ADS1X9X_TRIGGER
endchoice

config ADS1X9X_TRIGGER
	bool
	depends on ADS1X9X

config ADS1X9X_THREAD_PRIORITY
	int "Own thread priority"
	depends on ADS1X9X && ADS1X9X_TRIGGER_OWN_THREAD
	default 10
	help
	  The priority of the thread used for handling interrupts.

config ADS1X9X_THREAD_STACK_SIZE
	int "Own thread stack size"
	depends on ADS1X9X && ADS1X9X_TRIGGER_OWN_THREAD
	default 1024
	help
	  The thread stack size.

config ADS1X9X_GPIO_DEV_NAME
	string "Gpio device"
	default "GPIO_0"
	depends on ADS1X9X && ADS1X9X_TRIGGER
	help
	  The name of the GPIO device to which the ADS1X9X start&ready&reset pin is
	  connected.

config ADS1X9X_READY_GPIO_PIN_NUM
	int "Interrupt GPIO pin number"
	default 23
	depends on ADS1X9X && ADS1X9X_TRIGGER
	help
	  The number of the GPIO pin which is connected to ADS1X9X interrupt pin.

config ADS1X9X_START_GPIO_PIN_NUM
	int "Start GPIO pin number"
	default 21
	depends on ADS1X9X
	help
	  The number of the GPIO pin which is connected to ADS1X9X start pin.

config ADS1X9X_RESET_GPIO_PIN_NUM
	int "Reset GPIO pin number"
	default 22
	depends on ADS1X9X
	help
	  The number of the GPIO pin which is connected to ADS1X9X reset pin.

choice
	prompt "Ads1x9x power mode"
	depends on ADS1X9X
	default ADS1X9X_PMU_RUNTIME

config ADS1X9X_PMU_RUNTIME
	bool "Set at runtime."
	depends on ADS1X9X

config ADS1X9X_PMU_SUSPEND
	bool "suspended/not used"
	depends on ADS1X9X

config ADS1X9X_PMU_NORMAL
	bool "normal"
	depends on ADS1X9X

config ADS1X9X_PMU_LOW_POWER
	bool "low power"
	depends on ADS1X9X
endchoice
```

## drivers/sensor/max30205/Kconfig
```kconfig
#
# Copyright (c) 2016 Intel Corporation
#
# SPDX-License-Identifier: Apache-2.0
#

menuconfig MAX30205
	bool
	prompt "MAX30205 temperature and humidity sensor"
	depends on I2C
	help
	  Enable driver for MAX30205 I2C-based temperature and humidity sensor.

if !HAS_DTS_I2C_DEVICE

config MAX30205_NAME
	string
	prompt "Driver name"
	default "MAX30205"
	depends on MAX30205
	help
	  Device name with which the MAX30205 sensor is identified.

config MAX30205_I2C_ADDR
	hex
	prompt "I2c address"
	default 0x48
	depends on MAX30205
	help
	  Device addr with which the MAX30205 sensor is identified.

config MAX30205_I2C_MASTER_DEV_NAME
	string
	prompt "I2C master where MAX30205 is connected"
	depends on MAX30205
	default "I2C_0"
	help
	  Specify the device name of the I2C master device to which MAX30205 is
	  connected.

endif
```
