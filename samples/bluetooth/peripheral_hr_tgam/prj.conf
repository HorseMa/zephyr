## CMakeLists.txt
```
include($ENV{ZEPHYR_BASE}/cmake/app/boilerplate.cmake NO_POLICY_SCOPE)
project(NONE)

FILE(GLOB app_sources src/*.c)
target_sources(app PRIVATE
  ${app_sources}
  )

zephyr_library_include_directories($ENV{ZEPHYR_BASE}/samples/bluetooth)
```

## sample.yaml
```
sample:
  description: TBD
    using K_THREAD_DEFINE
  name: TBD
tests:
  test:
    harness: bluetooth
    platform_whitelist: qemu_cortex_m3 qemu_x86
    tags: bluetooth
```

## prj.conf
```kconfig
# CONFIG_PRINTK=y
# CONFIG_HEAP_MEM_POOL_SIZE=256
# CONFIG_LOG=y
# CONFIG_SYS_LOG=y
# CONFIG_SYS_LOG_DEFAULT_LEVEL=4
# CONFIG_SYS_LOG_OVERRIDE_LEVEL=4
# CONFIG_SYS_LOG_SPI_LEVEL=4
# CONFIG_SYS_LOG_I2C_LEVEL=4
# CONFIG_CONSOLE_SUBSYS=y
# CONFIG_CONSOLE_GETLINE=y
# CONFIG_NEWLIB_LIBC=y
# CONFIG_NEWLIB_LIBC_FLOAT_PRINTF=y
# CONFIG_NEWLIB_LIBC_FLOAT_SCANF=y
CONFIG_BT=y
# CONFIG_BT_DEBUG_LOG=y
CONFIG_BT_SMP=y
CONFIG_BT_PERIPHERAL=y
CONFIG_BT_DEVICE_NAME="Estack TGAM"
CONFIG_BT_DEVICE_APPEARANCE=833
```

## src/main.c
```c
/* main.c - Application main entry point */

/*
 * Copyright (c) 2015-2016 Intel Corporation
 *
 * SPDX-License-Identifier: Apache-2.0
 */

#include <zephyr/types.h>
#include <stddef.h>
#include <string.h>
#include <errno.h>
#include <misc/printk.h>
#include <misc/byteorder.h>
#include <zephyr.h>
#include <device.h>
#include <gpio.h>

#include <bluetooth/bluetooth.h>
#include <bluetooth/hci.h>
#include <bluetooth/conn.h>
#include <bluetooth/uuid.h>
#include <bluetooth/gatt.h>

#include "dis.h"
#include "bas.h"
#include "gps.h"

#define PORT      "GPIO_0"

struct bt_conn *default_conn;

static const struct bt_data ad[] = {
	BT_DATA_BYTES(BT_DATA_FLAGS, (BT_LE_AD_GENERAL | BT_LE_AD_NO_BREDR)),
	BT_DATA_BYTES(BT_DATA_UUID16_ALL, 0x0d, 0x18, 0x0f, 0x18, 0x05, 0x18, 0x09, 0x18),
};

void leda_work_handler(struct k_work *work)
{
    /* do the processing that needs to be done periodically */
}

K_WORK_DEFINE(leda_work, leda_work_handler);

void leda_timer_handler(struct k_timer *dummy)
{
    k_work_submit(&leda_work);
}

K_TIMER_DEFINE(leda_timer, leda_timer_handler, NULL);

static void connected(struct bt_conn *conn, u8_t err)
{
	if (err) {
		printk("Connection failed (err %u)\n", err);
	} else {
		default_conn = bt_conn_ref(conn);
		printk("Connected\n");
	}
}

static void disconnected(struct bt_conn *conn, u8_t reason)
{
	printk("Disconnected (reason %u)\n", reason);

	if (default_conn) {
		bt_conn_unref(default_conn);
		default_conn = NULL;
	}
}

static struct bt_conn_cb conn_callbacks = {
	.connected = connected,
	.disconnected = disconnected,
};

static void bt_ready(int err)
{
	if (err) {
		printk("Bluetooth init failed (err %d)\n", err);
		return;
	}

	printk("Bluetooth initialized\n");

	gps_init(0x01);
	bas_init();
	dis_init(CONFIG_SOC, "Manufacturer");

	err = bt_le_adv_start(BT_LE_ADV_CONN_NAME, ad, ARRAY_SIZE(ad), NULL, 0);
	if (err) {
		printk("Advertising failed to start (err %d)\n", err);
		return;
	}

	printk("Advertising successfully started\n");
}

static void auth_cancel(struct bt_conn *conn)
{
	char addr[BT_ADDR_LE_STR_LEN];

	bt_addr_le_to_str(bt_conn_get_dst(conn), addr, sizeof(addr));

	printk("Pairing cancelled: %s\n", addr);
}

static struct bt_conn_auth_cb auth_cb_display = {
	.cancel = auth_cancel,
};

extern void detectbattary(void);

void main(void)
{
	int err;
	struct device *gpiob;
	u32_t value;

	/* start periodic timer that expires once every second */
	k_timer_start(&leda_timer, K_SECONDS(1), K_SECONDS(1));

	err = bt_enable(bt_ready);
	if (err) {
		printk("Bluetooth init failed (err %d)\n", err);
		return;
	}

	bt_conn_cb_register(&conn_callbacks);
	bt_conn_auth_cb_register(&auth_cb_display);

	/*k_thread_create(&thread_data, stack, STACK_SIZE,
		(k_thread_entry_t) mpu6050,
		NULL, NULL, NULL, K_PRIO_COOP(7), 0, 0);*/
	/* Implement notification. At the moment there is no suitable way
	 * of starting delayed work so we do it here
	 */
	while (1) {
		k_sleep(50);

		/* Heartrate measurements simulation */
		//hrs_notify();

		detectbattary();
		/* Battery level simulation */
		bas_notify();
	}
}
```

## src/bas.c
```c
/** @file
 *  @brief BAS Service sample
 */

/*
 * Copyright (c) 2016 Intel Corporation
 *
 * SPDX-License-Identifier: Apache-2.0
 */

#include <zephyr/types.h>
#include <stddef.h>
#include <string.h>
#include <errno.h>
#include <misc/printk.h>
#include <misc/byteorder.h>
#include <zephyr.h>
#include <device.h>
#include <gpio.h>
#include <misc/__assert.h>
#include <board.h>
#include <sensor.h>
#include <adc.h>

#include <bluetooth/bluetooth.h>
#include <bluetooth/hci.h>
#include <bluetooth/conn.h>
#include <bluetooth/uuid.h>
#include <bluetooth/gatt.h>

#if defined(CONFIG_BOARD_NRF51_ESTACK_TGAM)

#include <nrfx_adc.h>
#define ADC_DEVICE_NAME		CONFIG_ADC_0_NAME
#define ADC_RESOLUTION		10
#define ADC_GAIN		ADC_GAIN_1_3
#define ADC_REFERENCE		ADC_REF_INTERNAL
#define ADC_ACQUISITION_TIME	ADC_ACQ_TIME_DEFAULT
#define ADC_CHANNEL_0_INPUT	NRF_ADC_CONFIG_INPUT_3
#define ADC_CHANNEL_2_INPUT	NRF_ADC_CONFIG_INPUT_3

#elif defined(CONFIG_BOARD_NRF52_PCA10040) || \
      defined(CONFIG_BOARD_NRF52840_PCA10056)

#include <nrfx_saadc.h>
#define ADC_DEVICE_NAME		CONFIG_ADC_0_NAME
#define ADC_RESOLUTION		10
#define ADC_GAIN		ADC_GAIN_1_6
#define ADC_REFERENCE		ADC_REF_INTERNAL
#define ADC_ACQUISITION_TIME	ADC_ACQ_TIME(ADC_ACQ_TIME_MICROSECONDS, 10)
#define ADC_CHANNEL_0_INPUT	NRF_SAADC_INPUT_AIN1
#define ADC_CHANNEL_2_INPUT	NRF_SAADC_INPUT_AIN2

#else
#error "Unsupported board."
#endif

#define PORT      "GPIO_0"

#define BUFFER_SIZE  6
static s16_t m_sample_buffer[BUFFER_SIZE];

static struct bt_gatt_ccc_cfg  blvl_ccc_cfg[BT_GATT_CCC_MAX] = {};
static u8_t simulate_blvl;
static u8_t battery = 100;

static const struct adc_channel_cfg m_channel_0_cfg = {
	.gain             = ADC_GAIN,
	.reference        = ADC_REFERENCE,
	.acquisition_time = ADC_ACQUISITION_TIME,
	.channel_id       = 0,
	.differential     = false,
	.input_positive   = ADC_CHANNEL_0_INPUT,
};

static struct device *adc_dev;
static float battery_v = 0.0;
static uint8_t alarm_flag = false;

static struct device *init_adc(void)
{
	int ret;
	adc_dev = device_get_binding(ADC_DEVICE_NAME);

	if (adc_dev == NULL) {
		printk("Could not get ADC_0 device\n");
		return NULL;
	}

	ret = adc_channel_setup(adc_dev, &m_channel_0_cfg);
	if(ret < 0)
	{
		printk("adc_channel_setup error!!!\n");
	}
	memset(m_sample_buffer, 0, sizeof(m_sample_buffer));

	return adc_dev;
}

/*static void check_samples(int expected_count)
{
	int i;

	printk("Samples read: ");
	for (i = 0; i < BUFFER_SIZE; i++) {
		s16_t sample_value = m_sample_buffer[i];

		printk("0x%04x ", sample_value);
	}
	printk("\n");
}*/

static void blvl_ccc_cfg_changed(const struct bt_gatt_attr *attr,
				 u16_t value)
{
	simulate_blvl = (value == BT_GATT_CCC_NOTIFY) ? 1 : 0;
}

static ssize_t read_blvl(struct bt_conn *conn, const struct bt_gatt_attr *attr,
			 void *buf, u16_t len, u16_t offset)
{
	const char *value = attr->user_data;

	return bt_gatt_attr_read(conn, attr, buf, len, offset, value,
				 sizeof(*value));
}

/* Battery Service Declaration */
static struct bt_gatt_attr attrs[] = {
	BT_GATT_PRIMARY_SERVICE(BT_UUID_BAS),
	BT_GATT_CHARACTERISTIC(BT_UUID_BAS_BATTERY_LEVEL,
			       BT_GATT_CHRC_READ | BT_GATT_CHRC_NOTIFY,
			       BT_GATT_PERM_READ, read_blvl, NULL, &battery),
	BT_GATT_CCC(blvl_ccc_cfg, blvl_ccc_cfg_changed),
};

static struct bt_gatt_service bas_svc = BT_GATT_SERVICE(attrs);

void bas_init(void)
{
	init_adc();

	if (!adc_dev) {
		return;
	}
	bt_gatt_service_register(&bas_svc);
}

//extern void power_off(struct device *gpiob);

void detectbattary(void)
{
	int ret;
	const struct adc_sequence sequence = {
		.channels    = BIT(0),
		.buffer      = m_sample_buffer,
		.buffer_size = sizeof(m_sample_buffer),
		.resolution  = ADC_RESOLUTION,
	};
	struct device *gpiob;

	gpiob = device_get_binding(PORT);
	if (!gpiob) {
		printk("error\n");
		//return;
	}

	ret = adc_read(adc_dev, &sequence);

	if(ret < 0)
	{
		printk("adc_read() failed\n");
	}
	battery_v = (s16_t)m_sample_buffer[0] / (float)1024 * 3 * 1.2 * 710 / 200;
	//printk("battery voltage is %f\n",battery_v);
	if(battery_v >= 4.05)
	{
		battery = 100;
	}
	else if(battery_v <= 3.35)
	{
		battery = 0;
		// system off (shutdown)
		//power_off(gpiob);
	}
	else
	{
		battery = (uint8_t)((battery_v - 3.35) / (4.05 - 3.35) * 100);
		if((battery_v <= 3.45) && (alarm_flag == false))
		{
			// 低电量报警
			alarm_flag = true;
			gpio_pin_configure(gpiob, 10,
			GPIO_DIR_OUT);
			gpio_pin_write(gpiob, 10, 1); // buzzer
			k_busy_wait(200000);
			gpio_pin_write(gpiob, 10, 0); // buzzer
			k_busy_wait(200000);
			gpio_pin_write(gpiob, 10, 1); // buzzer
			k_busy_wait(2000000);
			gpio_pin_write(gpiob, 10, 0); // buzzer
		}
	}
}

void bas_notify(void)
{
	static int loop = 0;

	if(loop != 0)
	{
		loop ++;
		if(loop == 100)
		{
			loop = 0;
		}
		return;
	}

	//printk("battery : %d%\n",battery);
	bt_gatt_notify(NULL, &attrs[1], &battery, sizeof(battery));
}
```

## src/gps.c
```c
/** @file
 *  @brief GPS Service sample
 */

/*
 * Copyright (c) 2016 Intel Corporation
 *
 * SPDX-License-Identifier: Apache-2.0
 */

#include <zephyr/types.h>
#include <stddef.h>
#include <string.h>
#include <errno.h>
#include <misc/printk.h>
#include <misc/byteorder.h>
#include <zephyr.h>

#include <sensor.h>
#include <device.h>
#include <bluetooth/bluetooth.h>
#include <bluetooth/hci.h>
#include <bluetooth/conn.h>
#include <bluetooth/uuid.h>
#include <bluetooth/gatt.h>
#include "gps.h"
#include <sensor.h>
#include <device.h>

#ifndef TRUE
#define TRUE     1
#endif
#ifndef FALSE
#define FALSE    0
#endif
#define BT_UUID_GPS                       BT_UUID_DECLARE_128(0x00, 0x00, 0x8B, 0x98, 0x42, 0xC2, 0x34, 0xA0,0x5C, 0x46, 0x84, 0x38, 0x88, 0x89, 0x86, 0x75)
#define BT_UUID_GPS_MEASUREMENT           BT_UUID_DECLARE_128(0x00, 0x00, 0x8B, 0x98, 0x42, 0xC2, 0x34, 0xA0,0x5C, 0x46, 0x84, 0x38, 0x66, 0x77, 0x86, 0x75)

static struct bt_gatt_ccc_cfg hrmc_ccc_cfg[BT_GATT_CCC_MAX] = {};
static u8_t simulate_hrm;
static u8_t gps_blsc;

static void hrmc_ccc_cfg_changed(const struct bt_gatt_attr *attr,
				 u16_t value)
{
	simulate_hrm = (value == BT_GATT_CCC_NOTIFY) ? 1 : 0;
}

/* Heart Rate Service Declaration */
static struct bt_gatt_attr attrs[] = {
	BT_GATT_PRIMARY_SERVICE(BT_UUID_GPS),
	BT_GATT_CHARACTERISTIC(BT_UUID_GPS_MEASUREMENT, BT_GATT_CHRC_NOTIFY,
			       BT_GATT_PERM_NONE, NULL, NULL, NULL),
	BT_GATT_CCC(hrmc_ccc_cfg, hrmc_ccc_cfg_changed),
};

static struct bt_gatt_service gps_svc = BT_GATT_SERVICE(attrs);

void gps_init(u8_t blsc)
{
	gps_blsc = blsc;
	int ret;

	ret = bt_gatt_service_register(&gps_svc);
	if(ret < 0)
	{
		printk("register gps Service err!\n");
	}
}

void gps_notify(char *data)
{
	//static u8_t location[100] = {0};
	/* Gps measurements simulation */
	if (!simulate_hrm) {
		return;
	}
	//memset(location,0,100);
	//strcpy(location,"38.6518,104.07642");
	bt_gatt_notify(NULL, &attrs[1], data, strlen(data));
}
```
