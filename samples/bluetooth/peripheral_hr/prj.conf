## prj.conf
```kconfig
# CONFIG_PRINTK=y
# CONFIG_HEAP_MEM_POOL_SIZE=256
# CONFIG_LOG=y
# CONFIG_SYS_LOG=y
# CONFIG_SYS_LOG_DEFAULT_LEVEL=4
# CONFIG_SYS_LOG_OVERRIDE_LEVEL=4
# CONFIG_SYS_LOG_SPI_LEVEL=4
# CONFIG_SYS_LOG_I2C_LEVEL=4
CONFIG_CONSOLE_SUBSYS=y
CONFIG_CONSOLE_GETLINE=y
CONFIG_NEWLIB_LIBC=y
CONFIG_NEWLIB_LIBC_FLOAT_PRINTF=y
CONFIG_NEWLIB_LIBC_FLOAT_SCANF=y
CONFIG_BT=y
CONFIG_BT_DEBUG_LOG=y
CONFIG_BT_CTLR_TX_PWR_0=n
CONFIG_BT_CTLR_TX_PWR_PLUS_4=y
CONFIG_BT_SMP=y
CONFIG_BT_PERIPHERAL=y
CONFIG_BT_DEVICE_NAME="Estack Heartrate Sensor"
CONFIG_BT_DEVICE_APPEARANCE=833
```

## src/main.c
```c
/* main.c - Application main entry point */

/*
 * Copyright (c) 2015-2016 Intel Corporation
 *
 * SPDX-License-Identifier: Apache-2.0
 */

#include <zephyr/types.h>
#include <stddef.h>
#include <string.h>
#include <errno.h>
#include <misc/printk.h>
#include <misc/byteorder.h>
#include <zephyr.h>
#include <device.h>
#include <gpio.h>

#include <bluetooth/bluetooth.h>
#include <bluetooth/hci.h>
#include <bluetooth/conn.h>
#include <bluetooth/uuid.h>
#include <bluetooth/gatt.h>

#include "hrs.h"
#include "dis.h"
#include "bas.h"
#include "htp.h"
#include "step.h"
#include "ecg.h"
#include "pid.h"
#include "resp.h"
#include "gps.h"

#define PORT      "GPIO_0"

struct bt_conn *default_conn;
extern bool bt_connect_flag;

static const struct bt_data ad[] = {
	BT_DATA_BYTES(BT_DATA_FLAGS, (BT_LE_AD_GENERAL | BT_LE_AD_NO_BREDR)),
	BT_DATA_BYTES(BT_DATA_UUID16_ALL, 0x0d, 0x18, 0x0f, 0x18, 0x05, 0x18, 0x09, 0x18),
};

static void connected(struct bt_conn *conn, u8_t err)
{
	if (err) {
		printk("Connection failed (err %u)\n", err);
	} else {
		default_conn = bt_conn_ref(conn);
		printk("Connected\n");
		bt_connect_flag = true;
	}
}

static void disconnected(struct bt_conn *conn, u8_t reason)
{
	printk("Disconnected (reason %u)\n", reason);

	if (default_conn) {
		bt_conn_unref(default_conn);
		default_conn = NULL;
		bt_connect_flag =  false;
	}
}

static struct bt_conn_cb conn_callbacks = {
	.connected = connected,
	.disconnected = disconnected,
};

static void bt_ready(int err)
{
	if (err) {
		printk("Bluetooth init failed (err %d)\n", err);
		return;
	}

	printk("Bluetooth initialized\n");

	hrs_init(0x01);
	ecg_init(0x01);
	resp_init(0x01);
	gps_init(0x01);
	pid_init(0x01);
	step_init(0x01);
	htp_init(0x01);
	bas_init();
	dis_init(CONFIG_SOC, "Manufacturer");

	err = bt_le_adv_start(BT_LE_ADV_CONN_NAME, ad, ARRAY_SIZE(ad), NULL, 0);
	if (err) {
		printk("Advertising failed to start (err %d)\n", err);
		return;
	}

	printk("Advertising successfully started\n");
}

static void auth_cancel(struct bt_conn *conn)
{
	char addr[BT_ADDR_LE_STR_LEN];

	bt_addr_le_to_str(bt_conn_get_dst(conn), addr, sizeof(addr));

	printk("Pairing cancelled: %s\n", addr);
}

static struct bt_conn_auth_cb auth_cb_display = {
	.cancel = auth_cancel,
};

/*#define STACK_SIZE		1024
K_THREAD_STACK_DEFINE(stack, STACK_SIZE);
static struct k_thread thread_data;
void mpu6050(void);
*/
extern void detectbattary(void);

void main(void)
{
	int err;
	struct device *gpiob;
	u32_t value;

	printk("Press the user defined button on the board\n");
	gpiob = device_get_binding(PORT);
	if (!gpiob) {
		printk("error\n");
		return;
	}

	err = bt_enable(bt_ready);
	if (err) {
		printk("Bluetooth init failed (err %d)\n", err);
		return;
	}

	bt_conn_cb_register(&conn_callbacks);
	bt_conn_auth_cb_register(&auth_cb_display);

	/*k_thread_create(&thread_data, stack, STACK_SIZE,
		(k_thread_entry_t) mpu6050,
		NULL, NULL, NULL, K_PRIO_COOP(7), 0, 0);*/
	/* Implement notification. At the moment there is no suitable way
	 * of starting delayed work so we do it here
	 */
	while (1) {
		k_sleep(50);

		/* Heartrate measurements simulation */
		//hrs_notify();
		gpio_pin_read(gpiob, 9,&value);
		if(value == 1)
		{
			step_notify();
			htp_notify();
		}
		detectbattary();
		/* Battery level simulation */
		bas_notify();
	}
}
```

## src/bas.c
```c
/** @file
 *  @brief BAS Service sample
 */

/*
 * Copyright (c) 2016 Intel Corporation
 *
 * SPDX-License-Identifier: Apache-2.0
 */

#include <zephyr/types.h>
#include <stddef.h>
#include <string.h>
#include <errno.h>
#include <misc/printk.h>
#include <misc/byteorder.h>
#include <zephyr.h>
#include <device.h>
#include <gpio.h>
#include <misc/__assert.h>
#include <board.h>
#include <sensor.h>
#include "mymath.h"
#include <adc.h>

#include <bluetooth/bluetooth.h>
#include <bluetooth/hci.h>
#include <bluetooth/conn.h>
#include <bluetooth/uuid.h>
#include <bluetooth/gatt.h>

#if defined(CONFIG_BOARD_NRF51_ESTACK_ECG)

#include <nrfx_adc.h>
#define ADC_DEVICE_NAME		CONFIG_ADC_0_NAME
#define ADC_RESOLUTION		10
#define ADC_GAIN		ADC_GAIN_1_3
#define ADC_REFERENCE		ADC_REF_INTERNAL
#define ADC_ACQUISITION_TIME	ADC_ACQ_TIME_DEFAULT
#define ADC_CHANNEL_0_INPUT	NRF_ADC_CONFIG_INPUT_7
#define ADC_CHANNEL_2_INPUT	NRF_ADC_CONFIG_INPUT_7

#elif defined(CONFIG_BOARD_NRF52_PCA10040) || \
      defined(CONFIG_BOARD_NRF52840_PCA10056)

#include <nrfx_saadc.h>
#define ADC_DEVICE_NAME		CONFIG_ADC_0_NAME
#define ADC_RESOLUTION		10
#define ADC_GAIN		ADC_GAIN_1_6
#define ADC_REFERENCE		ADC_REF_INTERNAL
#define ADC_ACQUISITION_TIME	ADC_ACQ_TIME(ADC_ACQ_TIME_MICROSECONDS, 10)
#define ADC_CHANNEL_0_INPUT	NRF_SAADC_INPUT_AIN1
#define ADC_CHANNEL_2_INPUT	NRF_SAADC_INPUT_AIN2

#else
#error "Unsupported board."
#endif

#define PORT      "GPIO_0"

#define BUFFER_SIZE  6
static s16_t m_sample_buffer[BUFFER_SIZE];

static struct bt_gatt_ccc_cfg  blvl_ccc_cfg[BT_GATT_CCC_MAX] = {};
static u8_t simulate_blvl;
static u8_t battery = 100;

static const struct adc_channel_cfg m_channel_0_cfg = {
	.gain             = ADC_GAIN,
	.reference        = ADC_REFERENCE,
	.acquisition_time = ADC_ACQUISITION_TIME,
	.channel_id       = 0,
	.differential     = false,
	.input_positive   = ADC_CHANNEL_0_INPUT,
};

static struct device *adc_dev;
static float battery_v = 0.0;
static uint8_t alarm_flag = false;

static struct device *init_adc(void)
{
	int ret;
	adc_dev = device_get_binding(ADC_DEVICE_NAME);

	if (adc_dev == NULL) {
		printk("Could not get ADC_0 device\n");
		return NULL;
	}

	ret = adc_channel_setup(adc_dev, &m_channel_0_cfg);
	if(ret < 0)
	{
		printk("adc_channel_setup error!!!\n");
	}
	memset(m_sample_buffer, 0, sizeof(m_sample_buffer));

	return adc_dev;
}

/*static void check_samples(int expected_count)
{
	int i;

	printk("Samples read: ");
	for (i = 0; i < BUFFER_SIZE; i++) {
		s16_t sample_value = m_sample_buffer[i];

		printk("0x%04x ", sample_value);
	}
	printk("\n");
}*/

static void blvl_ccc_cfg_changed(const struct bt_gatt_attr *attr,
				 u16_t value)
{
	simulate_blvl = (value == BT_GATT_CCC_NOTIFY) ? 1 : 0;
}

static ssize_t read_blvl(struct bt_conn *conn, const struct bt_gatt_attr *attr,
			 void *buf, u16_t len, u16_t offset)
{
	const char *value = attr->user_data;

	return bt_gatt_attr_read(conn, attr, buf, len, offset, value,
				 sizeof(*value));
}

/* Battery Service Declaration */
static struct bt_gatt_attr attrs[] = {
	BT_GATT_PRIMARY_SERVICE(BT_UUID_BAS),
	BT_GATT_CHARACTERISTIC(BT_UUID_BAS_BATTERY_LEVEL,
			       BT_GATT_CHRC_READ | BT_GATT_CHRC_NOTIFY,
			       BT_GATT_PERM_READ, read_blvl, NULL, &battery),
	BT_GATT_CCC(blvl_ccc_cfg, blvl_ccc_cfg_changed),
};

static struct bt_gatt_service bas_svc = BT_GATT_SERVICE(attrs);

void bas_init(void)
{
	init_adc();

	if (!adc_dev) {
		return;
	}
	bt_gatt_service_register(&bas_svc);
}

extern void power_off(struct device *gpiob);

void detectbattary(void)
{
	int ret;
	const struct adc_sequence sequence = {
		.channels    = BIT(0),
		.buffer      = m_sample_buffer,
		.buffer_size = sizeof(m_sample_buffer),
		.resolution  = ADC_RESOLUTION,
	};
	struct device *gpiob;

	gpiob = device_get_binding(PORT);
	if (!gpiob) {
		printk("error\n");
		//return;
	}

	ret = adc_read(adc_dev, &sequence);

	if(ret < 0)
	{
		printk("adc_read() failed\n");
	}
	battery_v = (s16_t)m_sample_buffer[0] / (float)1024 * 3 * 1.2 * 710 / 200;
	//printk("battery voltage is %f\n",battery_v);
	if(battery_v >= 4.05)
	{
		battery = 100;
	}
	else if(battery_v <= 3.35)
	{
		battery = 0;
		// system off (shutdown)
		power_off(gpiob);
	}
	else
	{
		battery = (uint8_t)((battery_v - 3.35) / (4.05 - 3.35) * 100);
		if((battery_v <= 3.45) && (alarm_flag == false))
		{
			// 低电量报警
			alarm_flag = true;
			gpio_pin_configure(gpiob, 23,
			GPIO_DIR_OUT);
			gpio_pin_write(gpiob, 23, 1); // buzzer
			k_busy_wait(200000);
			gpio_pin_write(gpiob, 23, 0); // buzzer
			k_busy_wait(200000);
			gpio_pin_write(gpiob, 23, 1); // buzzer
			k_busy_wait(2000000);
			gpio_pin_write(gpiob, 23, 0); // buzzer
		}
	}
}

void bas_notify(void)
{
	static int loop = 0;

	if(loop != 0)
	{
		loop ++;
		if(loop == 100)
		{
			loop = 0;
		}
		return;
	}

	//printk("battery : %d%\n",battery);
	bt_gatt_notify(NULL, &attrs[1], &battery, sizeof(battery));
}
```

## src/battery.c
```c
#include <zephyr.h>
#include <device.h>
#include <gpio.h>
#include <misc/printk.h>
#include <misc/__assert.h>
#include <board.h>
#include <string.h>
#include <sensor.h>
#include "mymath.h"
#include <adc.h>

/* size of stack area used by each thread */
#define STACKSIZE 1024

/* scheduling priority used by each thread */
#define PRIORITY 7

#if defined(CONFIG_BOARD_NRF51_ESTACK_ECG)

#include <nrfx_adc.h>
#define ADC_DEVICE_NAME		CONFIG_ADC_0_NAME
#define ADC_RESOLUTION		10
#define ADC_GAIN		ADC_GAIN_1_3
#define ADC_REFERENCE		ADC_REF_INTERNAL
#define ADC_ACQUISITION_TIME	ADC_ACQ_TIME_DEFAULT
#define ADC_CHANNEL_0_INPUT	NRF_ADC_CONFIG_INPUT_3
#define ADC_CHANNEL_2_INPUT	NRF_ADC_CONFIG_INPUT_3

#elif defined(CONFIG_BOARD_NRF52_PCA10040) || \
      defined(CONFIG_BOARD_NRF52840_PCA10056)

#include <nrfx_saadc.h>
#define ADC_DEVICE_NAME		CONFIG_ADC_0_NAME
#define ADC_RESOLUTION		10
#define ADC_GAIN		ADC_GAIN_1_6
#define ADC_REFERENCE		ADC_REF_INTERNAL
#define ADC_ACQUISITION_TIME	ADC_ACQ_TIME(ADC_ACQ_TIME_MICROSECONDS, 10)
#define ADC_CHANNEL_0_INPUT	NRF_SAADC_INPUT_AIN1
#define ADC_CHANNEL_2_INPUT	NRF_SAADC_INPUT_AIN2

#else
#error "Unsupported board."
#endif

#define BUFFER_SIZE  6
static s16_t m_sample_buffer[BUFFER_SIZE];

static const struct adc_channel_cfg m_channel_0_cfg = {
	.gain             = ADC_GAIN,
	.reference        = ADC_REFERENCE,
	.acquisition_time = ADC_ACQUISITION_TIME,
	.channel_id       = 0,
	.differential     = false,
	.input_positive   = ADC_CHANNEL_0_INPUT,
};

static struct device *init_adc(void)
{
	int ret;
	struct device *adc_dev = device_get_binding(ADC_DEVICE_NAME);

	if (adc_dev == NULL) {
		printk("Could not get ADC_0 device\n");
		return NULL;
	}

	ret = adc_channel_setup(adc_dev, &m_channel_0_cfg);
	if(ret < 0)
	{
		printk("adc_channel_setup error!!!\n");
	}
	memset(m_sample_buffer, 0, sizeof(m_sample_buffer));

	return adc_dev;
}

static void check_samples(int expected_count)
{
	int i;

	printk("Samples read: ");
	for (i = 0; i < BUFFER_SIZE; i++) {
		s16_t sample_value = m_sample_buffer[i];

		printk("0x%04x ", sample_value);
	}
	printk("\n");
}

void battery(void)
{
	int ret;
	float battery_v = 0.0;
	const struct adc_sequence sequence = {
		.channels    = BIT(0),
		.buffer      = m_sample_buffer,
		.buffer_size = sizeof(m_sample_buffer),
		.resolution  = ADC_RESOLUTION,
	};

	struct device *adc_dev = init_adc();

	if (!adc_dev) {
		return;
	}
	ret = adc_read(adc_dev, &sequence);

	if(ret < 0)
	{
		printk("adc_read() failed\n");
	}
	battery_v = (s16_t)m_sample_buffer[0] / (float)1024 * 3 * 1.2 * 710 / 200;
	printk("battery voltage is %f\n",battery_v);
	check_samples(1);
}

K_THREAD_DEFINE(battery_id, STACKSIZE, battery, NULL, NULL, NULL,
		PRIORITY, 0, K_NO_WAIT);
```

## src/button.c
```c
#include <zephyr.h>
#include <board.h>
#include <device.h>
#include <gpio.h>
#include <misc/util.h>
#include <misc/printk.h>
#include <nrf_power.h>

/* size of stack area used by each thread */
#define STACKSIZE 1024

/* scheduling priority used by each thread */
#define PRIORITY 7

#define PORT      "GPIO_0"
#define KEYAPIN       01
#define KEYBPIN       00
#define KEYGPIN       9

/* Sleep time */
#define SLEEP_TIME	500
#define PULL_UP SW0_GPIO_PIN_PUD
#define EDGE    (GPIO_INT_EDGE | GPIO_INT_ACTIVE_LOW)
#define GPIO_CFG_SENSE_LOW (GPIO_PIN_CNF_SENSE_Low << GPIO_PIN_CNF_SENSE_Pos)

extern int nrf_gpiote_interrupt_enable(uint32_t mask);
extern void nrf_gpiote_clear_port_event(void);

static void _system_off(void)
{
	nrf_power_system_off();
}

void power_off(struct device *gpiob)
{
	u32_t value;

	gpio_pin_configure(gpiob, 23,
			GPIO_DIR_OUT);
	gpio_pin_write(gpiob, 23, 1); // buzzer
	do{
		k_busy_wait(100000);
		gpio_pin_read(gpiob, KEYAPIN,&value);
	}while(value == 0);
	gpio_pin_configure(gpiob, 23,
			GPIO_DIR_OUT);
	gpio_pin_write(gpiob, 23, 0); // buzzer
	gpio_pin_configure(gpiob, 8,
			GPIO_DIR_OUT);
	gpio_pin_write(gpiob, 8, 0); // LDO
	gpio_pin_configure(gpiob, 24,
			GPIO_DIR_OUT);
	gpio_pin_write(gpiob, 24, 0); // LDO
	gpio_pin_configure(gpiob, 25,
			GPIO_DIR_OUT);
	gpio_pin_write(gpiob, 25, 0); // LED0
	gpio_pin_configure(gpiob, 28,
			GPIO_DIR_OUT);
	gpio_pin_write(gpiob, 28, 0); // LED1
	gpio_pin_configure(gpiob, 29,
			GPIO_DIR_OUT);
	gpio_pin_write(gpiob, 29, 0); // LED2
	gpio_pin_configure(gpiob, CONFIG_ADS1X9X_START_GPIO_PIN_NUM,
			GPIO_DIR_OUT);
	gpio_pin_write(gpiob, CONFIG_ADS1X9X_START_GPIO_PIN_NUM, 0); // ads start pin
	gpio_pin_configure(gpiob, CONFIG_ADS1X9X_RESET_GPIO_PIN_NUM,
			GPIO_DIR_OUT);
	gpio_pin_write(gpiob, CONFIG_ADS1X9X_RESET_GPIO_PIN_NUM, 0); // ads reset pin
	gpio_pin_configure(gpiob, CONFIG_ADS1X9X_READY_GPIO_PIN_NUM,
			GPIO_DIR_OUT);
	gpio_pin_write(gpiob, CONFIG_ADS1X9X_READY_GPIO_PIN_NUM, 0); // ads ready pin
	gpio_pin_configure(gpiob, CONFIG_ADS1X9X_SLAVE,
			GPIO_DIR_OUT);
	gpio_pin_write(gpiob, CONFIG_ADS1X9X_SLAVE, 0); // ads cs pin
	gpio_pin_configure(gpiob, 17,
			GPIO_DIR_OUT); // ads mosi
	gpio_pin_write(gpiob, 17,0);
	gpio_pin_configure(gpiob, 19,
			GPIO_DIR_OUT); // ads miso
	gpio_pin_write(gpiob, 19,0);
	gpio_pin_configure(gpiob, 18,
			GPIO_DIR_OUT); // ads sclk
	gpio_pin_write(gpiob, 18,0);
	gpio_pin_configure(gpiob, 10,
			GPIO_DIR_IN); // i2c sda
	//gpio_pin_write(gpiob, 30,1);
	gpio_pin_configure(gpiob, 11,
			GPIO_DIR_IN); // i2c scl
	gpio_pin_configure(gpiob, KEYGPIN,
			GPIO_DIR_IN); // GSR_LOF
	//gpio_pin_write(gpiob, 7,1);
	gpio_pin_configure(gpiob, KEYAPIN, GPIO_DIR_IN
			| GPIO_PUD_PULL_UP
			| GPIO_CFG_SENSE_LOW);
	nrf_gpiote_clear_port_event();
	/* Enable GPIOTE Port Event */
	nrf_gpiote_interrupt_enable(GPIOTE_INTENSET_PORT_Msk);
	NVIC_EnableIRQ(GPIOTE_IRQn);
	_system_off();
}

void button_pressed(struct device *gpiob, struct gpio_callback *cb,
		    u32_t pins)
{
	printk("Button pressed at pin : %08x, %d\n", pins, k_cycle_get_32());
	if(pins & BIT(KEYAPIN))
	{
		k_busy_wait(300000);

		power_off(gpiob);
	}
}

static struct gpio_callback gpio_cb_keya;
static struct gpio_callback gpio_cb_keyb;
static struct gpio_callback gpio_cb_keyi2c;

void button(void)
{
	struct device *gpiob;

	printk("Press the user defined button on the board\n");
	gpiob = device_get_binding(PORT);
	if (!gpiob) {
		printk("error\n");
		return;
	}

	gpio_pin_configure(gpiob, KEYAPIN,
			   GPIO_DIR_IN | GPIO_INT |  PULL_UP | EDGE);

	gpio_init_callback(&gpio_cb_keya, button_pressed, BIT(KEYAPIN));

	gpio_add_callback(gpiob, &gpio_cb_keya);
	gpio_pin_enable_callback(gpiob, KEYAPIN);

	gpio_pin_configure(gpiob, KEYBPIN,
			   GPIO_DIR_IN | GPIO_INT |  PULL_UP | EDGE);

	gpio_init_callback(&gpio_cb_keyb, button_pressed, BIT(KEYBPIN));

	gpio_add_callback(gpiob, &gpio_cb_keyb);
	gpio_pin_enable_callback(gpiob, KEYBPIN);

	gpio_pin_configure(gpiob, KEYGPIN,
			   GPIO_DIR_IN | GPIO_INT | EDGE);

	gpio_init_callback(&gpio_cb_keyi2c, button_pressed, BIT(KEYGPIN));

	gpio_add_callback(gpiob, &gpio_cb_keyi2c);
	gpio_pin_enable_callback(gpiob, KEYGPIN);

	while (1) {
		//u32_t val = 0;

		//gpio_pin_read(gpiob, PIN, &val);
		k_sleep(SLEEP_TIME);
	}
}

K_THREAD_DEFINE(button_id, STACKSIZE, button, NULL, NULL, NULL,
		PRIORITY, 0, K_NO_WAIT);
```

## src/ecg.c
```c
/** @file
 *  @brief ECG Service sample
 */

/*
 * Copyright (c) 2016 Intel Corporation
 *
 * SPDX-License-Identifier: Apache-2.0
 */

#include <zephyr/types.h>
#include <stddef.h>
#include <string.h>
#include <errno.h>
#include <misc/printk.h>
#include <misc/byteorder.h>
#include <zephyr.h>

#include <sensor.h>
#include <device.h>
#include <bluetooth/bluetooth.h>
#include <bluetooth/hci.h>
#include <bluetooth/conn.h>
#include <bluetooth/uuid.h>
#include <bluetooth/gatt.h>
#include "ecg.h"
#include <sensor.h>
#include <device.h>
#include <math.h>

#ifndef TRUE
#define TRUE     1
#endif
#ifndef FALSE
#define FALSE    0
#endif
#define BT_UUID_ECG                       BT_UUID_DECLARE_128(0x00, 0x00, 0x8B, 0x98, 0x42, 0xC2, 0x34, 0xA0,0x5C, 0x46, 0x84, 0x38, 0x09, 0x42, 0x86, 0x75)
#define BT_UUID_ECG_MEASUREMENT           BT_UUID_DECLARE_128(0x00, 0x00, 0x8B, 0x98, 0x42, 0xC2, 0x34, 0xA0,0x5C, 0x46, 0x84, 0x38, 0x25, 0x83, 0x86, 0x75)

static struct bt_gatt_ccc_cfg hrmc_ccc_cfg[BT_GATT_CCC_MAX] = {};
static u8_t simulate_hrm;
static u8_t ecg_blsc;

static void hrmc_ccc_cfg_changed(const struct bt_gatt_attr *attr,
				 u16_t value)
{
	simulate_hrm = (value == BT_GATT_CCC_NOTIFY) ? 1 : 0;
}

/* Heart Rate Service Declaration */
static struct bt_gatt_attr attrs[] = {
	BT_GATT_PRIMARY_SERVICE(BT_UUID_ECG),
	BT_GATT_CHARACTERISTIC(BT_UUID_ECG_MEASUREMENT, BT_GATT_CHRC_NOTIFY,
			       BT_GATT_PERM_NONE, NULL, NULL, NULL),
	BT_GATT_CCC(hrmc_ccc_cfg, hrmc_ccc_cfg_changed),
};

static struct bt_gatt_service ecg_svc = BT_GATT_SERVICE(attrs);

void ecg_init(u8_t blsc)
{
	ecg_blsc = blsc;
	int ret;

	ret = bt_gatt_service_register(&ecg_svc);
	if(ret < 0)
	{
		printk("register ecg Service err!\n");
	}
}

extern int16_t ecgrawdata[];
void ecg_notify(void)
{
	/* Heartrate measurements simulation */
	if (!simulate_hrm) {
		return;
	}

	bt_gatt_notify(NULL, &attrs[1], &ecgrawdata, 2 * 2 * 10);
}
```

## src/ecg.h
```c
/** @file
 *  @brief HRS Service sample
 */

/*
 * Copyright (c) 2016 Intel Corporation
 *
 * SPDX-License-Identifier: Apache-2.0
 */

#ifdef __cplusplus
extern "C" {
#endif

void ecg_init(u8_t blsc);
void ecg_notify(void);

#ifdef __cplusplus
}
#endif
```

## src/gps.c
```c
/** @file
 *  @brief GPS Service sample
 */

/*
 * Copyright (c) 2016 Intel Corporation
 *
 * SPDX-License-Identifier: Apache-2.0
 */

#include <zephyr/types.h>
#include <stddef.h>
#include <string.h>
#include <errno.h>
#include <misc/printk.h>
#include <misc/byteorder.h>
#include <zephyr.h>

#include <sensor.h>
#include <device.h>
#include <bluetooth/bluetooth.h>
#include <bluetooth/hci.h>
#include <bluetooth/conn.h>
#include <bluetooth/uuid.h>
#include <bluetooth/gatt.h>
#include "gps.h"
#include <sensor.h>
#include <device.h>
#include <math.h>

#ifndef TRUE
#define TRUE     1
#endif
#ifndef FALSE
#define FALSE    0
#endif
#define BT_UUID_GPS                       BT_UUID_DECLARE_128(0x00, 0x00, 0x8B, 0x98, 0x42, 0xC2, 0x34, 0xA0,0x5C, 0x46, 0x84, 0x38, 0x88, 0x89, 0x86, 0x75)
#define BT_UUID_GPS_MEASUREMENT           BT_UUID_DECLARE_128(0x00, 0x00, 0x8B, 0x98, 0x42, 0xC2, 0x34, 0xA0,0x5C, 0x46, 0x84, 0x38, 0x66, 0x77, 0x86, 0x75)

static struct bt_gatt_ccc_cfg hrmc_ccc_cfg[BT_GATT_CCC_MAX] = {};
static u8_t simulate_hrm;
static u8_t gps_blsc;

static void hrmc_ccc_cfg_changed(const struct bt_gatt_attr *attr,
				 u16_t value)
{
	simulate_hrm = (value == BT_GATT_CCC_NOTIFY) ? 1 : 0;
}

/* Heart Rate Service Declaration */
static struct bt_gatt_attr attrs[] = {
	BT_GATT_PRIMARY_SERVICE(BT_UUID_GPS),
	BT_GATT_CHARACTERISTIC(BT_UUID_GPS_MEASUREMENT, BT_GATT_CHRC_NOTIFY,
			       BT_GATT_PERM_NONE, NULL, NULL, NULL),
	BT_GATT_CCC(hrmc_ccc_cfg, hrmc_ccc_cfg_changed),
};

static struct bt_gatt_service gps_svc = BT_GATT_SERVICE(attrs);

void gps_init(u8_t blsc)
{
	gps_blsc = blsc;
	int ret;

	ret = bt_gatt_service_register(&gps_svc);
	if(ret < 0)
	{
		printk("register gps Service err!\n");
	}
}

void gps_notify(char *data)
{
	//static u8_t location[100] = {0};
	/* Gps measurements simulation */
	if (!simulate_hrm) {
		return;
	}
	//memset(location,0,100);
	//strcpy(location,"38.6518,104.07642");
	bt_gatt_notify(NULL, &attrs[1], data, strlen(data));
}
```

## src/gps.h
```c
/** @file
 *  @brief HRS Service sample
 */

/*
 * Copyright (c) 2016 Intel Corporation
 *
 * SPDX-License-Identifier: Apache-2.0
 */

#ifdef __cplusplus
extern "C" {
#endif

void gps_init(u8_t blsc);
void gps_notify(char *data);

#ifdef __cplusplus
}
#endif
```

## src/gpsbeidou.c
```c
/*
 * Copyright (c) 2017 Linaro Limited
 *
 * SPDX-License-Identifier: Apache-2.0
 */
#include <zephyr.h>
#include <device.h>
#include <gpio.h>
#include <misc/printk.h>
#include <misc/__assert.h>
#include <board.h>
#include <sensor.h>
#include <device.h>
#include "mymath.h"
#include <stdlib.h>
#include <math.h>
#include <string.h>
#include <console.h>
#include <unistd.h>
#include "gps.h"

/* size of stack area used by each thread */
#define STACKSIZE 1024

/* scheduling priority used by each thread */
#define PRIORITY 7

extern bool gps_work_flag;

void gpsbeidou(void)
{
	#if 1
	//struct device *gpio_dev;
	unsigned char *p,*pend;
	static u8_t data2send[100] = {0};
	static unsigned char lattempstr[20] = {0};
	static unsigned char longtempstr[20] = {0};
	static unsigned char startempstr[20] = {0};

	/*gpio_dev = device_get_binding("GPIO_0");
	__ASSERT_NO_MSG(gpio_dev != NULL);

	gpio_pin_configure(gpio_dev, 14,
			   GPIO_DIR_IN);
	gpio_pin_configure(gpio_dev, 17,
			   GPIO_DIR_OUT |  GPIO_PUD_PULL_UP);
	while (1) {
		u32_t val = 0;
		gpio_pin_read(gpio_dev, 14, &val);
		if(val == 1)
		{
			break;
		}
		else
		{
			k_sleep(200);
		}
	}*/

	console_getline_init();
	//gpio_pin_write(gpio_dev, 17,1);

	while (1) {
		int startcount = 0;
		char *s = console_getline();
		//printk("%s\r\n",s);
		p = strstr(s,"GNGGA");
		if(p)
		{
			//printk("got one!!!\n");
			memset(lattempstr,0,20);
			p = strstr(p,",");
			p = strstr(p + 1,",");
			pend = strstr(p + 1,",");
			memcpy(lattempstr,p + 1,pend - p - 1);
			//printk("%s\n",lattempstr);
			//lat = atof(p + 1);
			//atoi()
			//sscanf(tempstr,"%f",&lat);	// 纬度
			//printk("lat = %f\n",lat);
			memset(longtempstr,0,20);
			p = strstr(pend + 1,",");
			p = p + 1;
			pend = strstr(p,",");
			memcpy(longtempstr,p,pend - p); // 经度
			//printk("%s\n",longtempstr);
			p = strstr(pend + 1,",");
			p = strstr(p + 1,",");
			pend = strstr(p + 1,",");
			memset(startempstr,0,20);
			memcpy(startempstr,p + 1,pend - p - 1); // 卫星个数
			//printk("star count : %s\n",startempstr);
			startcount = atoi(startempstr);
			if(startcount > 3)
			{
				gps_work_flag = true;
			}
			else
			{
				gps_work_flag = false;
			}
			memset(data2send,0,100);
			strcat(data2send,startempstr);
			strcat(data2send,",");
			strcat(data2send,lattempstr);
			strcat(data2send,",");
			strcat(data2send,longtempstr);
			//printk("%s\n",data2send);
			gps_notify(data2send);
		}
	}
	#endif
}

K_THREAD_DEFINE(gpsbeidou_id, STACKSIZE, gpsbeidou, NULL, NULL, NULL,
		PRIORITY, 0, K_NO_WAIT);
```

## src/hrs.c
```c
/** @file
 *  @brief HRS Service sample
 */

/*
 * Copyright (c) 2016 Intel Corporation
 *
 * SPDX-License-Identifier: Apache-2.0
 */

#include <zephyr/types.h>
#include <stddef.h>
#include <string.h>
#include <errno.h>
#include <misc/printk.h>
#include <misc/byteorder.h>
#include <zephyr.h>

#include <sensor.h>
#include <device.h>
#include <bluetooth/bluetooth.h>
#include <bluetooth/hci.h>
#include <bluetooth/conn.h>
#include <bluetooth/uuid.h>
#include <bluetooth/gatt.h>
#include "hrs.h"
#include "ecg.h"
#include "resp.h"

static struct bt_gatt_ccc_cfg hrmc_ccc_cfg[BT_GATT_CCC_MAX] = {};
static u8_t simulate_hrm;
static u8_t heartrate = 90;
static u8_t resprate = 0;
static u8_t hrs_blsc;
extern unsigned long stepCount; /* 步数值 */

static void hrmc_ccc_cfg_changed(const struct bt_gatt_attr *attr,
				 u16_t value)
{
	simulate_hrm = (value == BT_GATT_CCC_NOTIFY) ? 1 : 0;
}

static ssize_t read_blsc(struct bt_conn *conn, const struct bt_gatt_attr *attr,
			 void *buf, u16_t len, u16_t offset)
{
	return bt_gatt_attr_read(conn, attr, buf, len, offset, &hrs_blsc,
				 sizeof(hrs_blsc));
}

/* Heart Rate Service Declaration */
static struct bt_gatt_attr attrs[] = {
	BT_GATT_PRIMARY_SERVICE(BT_UUID_HRS),
	BT_GATT_CHARACTERISTIC(BT_UUID_HRS_MEASUREMENT, BT_GATT_CHRC_NOTIFY,
			       BT_GATT_PERM_NONE, NULL, NULL, NULL),
	BT_GATT_CCC(hrmc_ccc_cfg, hrmc_ccc_cfg_changed),
	BT_GATT_CHARACTERISTIC(BT_UUID_HRS_BODY_SENSOR, BT_GATT_CHRC_READ,
			       BT_GATT_PERM_READ, read_blsc, NULL, NULL),
	BT_GATT_CHARACTERISTIC(BT_UUID_HRS_CONTROL_POINT, BT_GATT_CHRC_WRITE,
			       BT_GATT_PERM_NONE, NULL, NULL, NULL),
};

static struct bt_gatt_service hrs_svc = BT_GATT_SERVICE(attrs);
int16_t ecgrawdata[2 * 10];
static u8_t rawdatacount = 0;
static void trigger_handler(struct device *ads1x9x, struct sensor_trigger *trigger)
{
	struct sensor_value val[3];
	static int loop = 0;

	if (trigger->type != SENSOR_TRIG_DATA_READY &&
	    trigger->type != SENSOR_TRIG_DELTA) {
		printk("Ecg: trigger handler: unknown trigger type.\n");
		return;
	}

	/*if (sensor_sample_fetch(ads1x9x) < 0) {
		printk("Gyro sample update error.\n");
	}*/
	if(trigger->chan == SENSOR_CHAN_ACCEL_X)
	{
		if (sensor_channel_get(ads1x9x, SENSOR_CHAN_ACCEL_X, val) < 0) {
			printk("Cannot read ads1x9x raw channels.\n");
			return;
		}
		//printk("raw\n");
		if(!(loop ++ % 5))
		{
			ecgrawdata[rawdatacount * 2 + 0] = (int16_t)val[0].val1;
			ecgrawdata[rawdatacount * 2 + 1] = (int16_t)val[0].val2;
			//printk("%d,%d,%d\n",1,ecgrawdata[rawdatacount * 2 + 0],ecgrawdata[rawdatacount * 2 + 1]);
			//printk("%d,%d,%d\n",loop / 5,val[0].val1,val[0].val2);
			rawdatacount ++;
			if(rawdatacount >= 10)
			{
				rawdatacount = 0;
				ecg_notify();
			}
		}
		//loop ++;


	}
	else if(trigger->chan == SENSOR_CHAN_ACCEL_Y)
	{
		if (sensor_channel_get(ads1x9x, SENSOR_CHAN_ACCEL_Y, val) < 0) {
			printk("Cannot read ads1x9x heart channels.\n");
			return;
		}
		//printk("heart\n");
		heartrate = (u8_t)val[0].val1;
		hrs_notify();
	}
	else if(trigger->chan == SENSOR_CHAN_ACCEL_Z)
	{
		if (sensor_channel_get(ads1x9x, SENSOR_CHAN_ACCEL_Z, val) < 0) {
			printk("Cannot read ads1x9x resp channels.\n");
			return;
		}
		//printk("resp\n");
		resprate = (u8_t)val[0].val1;
		resp_notify(resprate);
	}
	else
	{

	}

}

void hrs_init(u8_t blsc)
{
	hrs_blsc = blsc;
	struct device *dev;
	struct sensor_trigger trig;

	printk("ADS1X9X sample application\n");
	dev = device_get_binding("ADS1X9X");

	if (!dev) {
		printk("sensor: device not found.\n");
		return;
	}

	trig.type = SENSOR_TRIG_DATA_READY;
	trig.chan = SENSOR_CHAN_ACCEL_X;
	if (sensor_trigger_set(dev, &trig, trigger_handler) < 0) {
		printk("Ecg: cannot set trigger.\n");
		return;
	}
	bt_gatt_service_register(&hrs_svc);
}

void hrs_notify(void)
{
	static u8_t hrm[2];

	/* Heartrate measurements simulation */
	if (!simulate_hrm) {
		return;
	}

	//heartrate++;
	/*if (heartrate == 160) {
		heartrate = 90;
	}*/

	hrm[0] = 0x06; /* uint8, sensor contact */
	hrm[1] = heartrate;

	bt_gatt_notify(NULL, &attrs[1], &hrm, sizeof(hrm));
}
```

## src/htp.c
```c
/** @file
 *  @brief HRS Service sample
 */

/*
 * Copyright (c) 2016 Intel Corporation
 *
 * SPDX-License-Identifier: Apache-2.0
 */

#include <zephyr/types.h>
#include <stddef.h>
#include <string.h>
#include <errno.h>
#include <misc/printk.h>
#include <misc/byteorder.h>
#include <zephyr.h>
#include <sensor.h>
#include <bluetooth/bluetooth.h>
#include <bluetooth/hci.h>
#include <bluetooth/conn.h>
#include <bluetooth/uuid.h>
#include <bluetooth/gatt.h>
#include "pid.h"

#define BLE_L2CAP_MTU_DEF           (23)
#define OPCODE_LENGTH 1                                                    /**< Length of opcode inside Health Thermometer Measurement packet. */
#define HANDLE_LENGTH 2                                                    /**< Length of handle inside Health Thermometer Measurement packet. */
#define MAX_HTM_LEN   (BLE_L2CAP_MTU_DEF - OPCODE_LENGTH - HANDLE_LENGTH)  /**< Maximum size of a transmitted Health Thermometer Measurement. */
#define MAX30205_TEMP_STEP		0.00390625f

// Health Thermometer Measurement flag bits
#define HTS_MEAS_FLAG_TEMP_UNITS_BIT (0x01 << 0)  /**< Temperature Units flag. */
#define HTS_MEAS_FLAG_TIME_STAMP_BIT (0x01 << 1)  /**< Time Stamp flag. */
#define HTS_MEAS_FLAG_TEMP_TYPE_BIT  (0x01 << 2)  /**< Temperature Type flag. */

#define BLE_UUID_HEALTH_THERMOMETER_SERVICE                      BT_UUID_DECLARE_16(0x1809)     /**< Health Thermometer service UUID. */
#define BLE_UUID_TEMPERATURE_MEASUREMENT_CHAR                    BT_UUID_DECLARE_16(0x2A1C)     /**< Temperature Measurement characteristic UUID. */
#define BLE_UUID_TEMPERATURE_TYPE_CHAR                           BT_UUID_DECLARE_16(0x2A1D)     /**< Temperature Type characteristic UUID. */
#define TEMP_TYPE_AS_CHARACTERISTIC     0                                           /**< Determines if temperature type is given as characteristic (1) or as a field of measurement (0). */
// Temperature Type measurement locations
#define BLE_HTS_TEMP_TYPE_ARMPIT      1
#define BLE_HTS_TEMP_TYPE_BODY        2
#define BLE_HTS_TEMP_TYPE_EAR         3
#define BLE_HTS_TEMP_TYPE_FINGER      4
#define BLE_HTS_TEMP_TYPE_GI_TRACT    5
#define BLE_HTS_TEMP_TYPE_MOUTH       6
#define BLE_HTS_TEMP_TYPE_RECTUM      7
#define BLE_HTS_TEMP_TYPE_TOE         8
#define BLE_HTS_TEMP_TYPE_EAR_DRUM    9

/**@brief Date and Time structure. */
typedef struct
{
    uint16_t year;
    uint8_t  month;
    uint8_t  day;
    uint8_t  hours;
    uint8_t  minutes;
    uint8_t  seconds;
} ble_date_time_t;

typedef struct
{
  int8_t  exponent;                                                         /**< Base 10 exponent */
  int32_t mantissa;                                                         /**< Mantissa, should be using only 24 bits */
} ieee_float32_t;

/**@brief Health Thermometer Service measurement structure. This contains a Health Thermometer
 *        measurement. */
typedef struct ble_hts_meas_s
{
    bool                         temp_in_fahr_units;                        /**< True if Temperature is in Fahrenheit units, Celcius otherwise. */
    bool                         time_stamp_present;                        /**< True if Time Stamp is present. */
    bool                         temp_type_present;                         /**< True if Temperature Type is present. */
    ieee_float32_t               temp_in_celcius;                           /**< Temperature Measurement Value (Celcius). */
    ieee_float32_t               temp_in_fahr;                              /**< Temperature Measurement Value (Fahrenheit). */
    ble_date_time_t              time_stamp;                                /**< Time Stamp. */
    uint8_t                      temp_type;                                 /**< Temperature Type. */
} ble_hts_meas_t;

static struct bt_gatt_ccc_cfg hrmc_ccc_cfg[BT_GATT_CCC_MAX] = {};
static u8_t simulate_hrm;
static u8_t htp_blsc;
static struct device *dev;
extern unsigned long stepCount; /* 步数值 */
static uint32_t celciusX100;

/*static uint8_t uint16_encode(uint16_t value, uint8_t * p_encoded_data)
{
    p_encoded_data[0] = (uint8_t) ((value & 0x00FF) >> 0);
    p_encoded_data[1] = (uint8_t) ((value & 0xFF00) >> 8);
    return sizeof(uint16_t);
}

static uint8_t uint32_encode(uint32_t value, uint8_t * p_encoded_data)
{
    p_encoded_data[0] = (uint8_t) ((value & 0x000000FF) >> 0);
    p_encoded_data[1] = (uint8_t) ((value & 0x0000FF00) >> 8);
    p_encoded_data[2] = (uint8_t) ((value & 0x00FF0000) >> 16);
    p_encoded_data[3] = (uint8_t) ((value & 0xFF000000) >> 24);
    return sizeof(uint32_t);
}*/

static void hrmc_ccc_cfg_changed(const struct bt_gatt_attr *attr,
				 u16_t value)
{
	simulate_hrm = (value == BT_GATT_CCC_NOTIFY) ? 1 : 0;
}

/*static ssize_t read_blsc(struct bt_conn *conn, const struct bt_gatt_attr *attr,
			 void *buf, u16_t len, u16_t offset)
{
	return bt_gatt_attr_read(conn, attr, buf, len, offset, &htp_blsc,
				 sizeof(htp_blsc));
}*/

/* Heart Rate Service Declaration */
static struct bt_gatt_attr attrs[] = {
	BT_GATT_PRIMARY_SERVICE(BLE_UUID_HEALTH_THERMOMETER_SERVICE),
	BT_GATT_CHARACTERISTIC(BLE_UUID_TEMPERATURE_MEASUREMENT_CHAR, BT_GATT_CHRC_NOTIFY,
			       BT_GATT_PERM_NONE, NULL, NULL, NULL),
	BT_GATT_CCC(hrmc_ccc_cfg, hrmc_ccc_cfg_changed),
	/*BT_GATT_CHARACTERISTIC(BLE_UUID_TEMPERATURE_TYPE_CHAR, BT_GATT_CHRC_READ,
			       BT_GATT_PERM_READ, read_blsc, NULL, NULL),*/
};

static struct bt_gatt_service htp_svc = BT_GATT_SERVICE(attrs);

u16_t pidrawdata[20];
static u8_t pidrawdatacount = 0;
static int hts_sim_measurement(ble_hts_meas_t * p_meas)
{
    //static ble_date_time_t time_stamp = { 2012, 12, 5, 11, 50, 0 };
    struct sensor_value temp;
    //static int loop = 0;

    if (sensor_sample_fetch(dev) < 0) {
		printk("Sensor sample update error\n");
		return -1;
	}

	if (sensor_channel_get(dev, SENSOR_CHAN_AMBIENT_TEMP, &temp) < 0) {
		printk("Cannot read MAX30205 temperature channel\n");
		return -1;
	}
    //printk("%d,%d\n",loop ++,temp.val2);
    pidrawdata[pidrawdatacount ++] = temp.val2;
    if(pidrawdatacount >= 20)
    {
        pidrawdatacount = 0;
        pid_notify();

        p_meas->temp_in_fahr_units = false;
        p_meas->time_stamp_present = false;
        p_meas->temp_type_present  = (TEMP_TYPE_AS_CHARACTERISTIC ? false : true);

        celciusX100 = (uint32_t)((float)temp.val1 * MAX30205_TEMP_STEP * 100);//3700;//sensorsim_measure(&m_temp_celcius_sim_state, &m_temp_celcius_sim_cfg);
        /*p_meas->temp_in_celcius.exponent = -2;
        p_meas->temp_in_celcius.mantissa = celciusX100;
        p_meas->temp_in_fahr.exponent    = -2;
        p_meas->temp_in_fahr.mantissa    = (32 * 100) + ((celciusX100 * 9) / 5);
        p_meas->time_stamp               = time_stamp;
        p_meas->temp_type                = BLE_HTS_TEMP_TYPE_FINGER;

        // update simulated time stamp
        time_stamp.seconds += 27;
        if (time_stamp.seconds > 59)
        {
            time_stamp.seconds -= 60;
            time_stamp.minutes++;
            if (time_stamp.minutes > 59)
            {
                time_stamp.minutes = 0;
            }
        }*/
        return 0;
    }
    else
    {
        return -1;
    }
}

#if 0
static uint8_t ble_date_time_encode(const ble_date_time_t * p_date_time,
                                             uint8_t *               p_encoded_data)
{
    uint8_t len = uint16_encode(p_date_time->year, p_encoded_data);

    p_encoded_data[len++] = p_date_time->month;
    p_encoded_data[len++] = p_date_time->day;
    p_encoded_data[len++] = p_date_time->hours;
    p_encoded_data[len++] = p_date_time->minutes;
    p_encoded_data[len++] = p_date_time->seconds;

    return len;
}

static uint8_t hts_measurement_encode(ble_hts_meas_t * p_hts_meas,
                                      uint8_t        * p_encoded_buffer)
{
    uint8_t  flags = 0;
    uint8_t  len   = 1;
    uint32_t encoded_temp;

    // Flags field
    if (p_hts_meas->temp_in_fahr_units)
    {
        flags |= HTS_MEAS_FLAG_TEMP_UNITS_BIT;
    }
    if (p_hts_meas->time_stamp_present)
    {
        flags |= HTS_MEAS_FLAG_TIME_STAMP_BIT;
    }

    // Temperature Measurement Value field
    if (p_hts_meas->temp_in_fahr_units)
    {
        flags |= HTS_MEAS_FLAG_TEMP_UNITS_BIT;

        encoded_temp = ((p_hts_meas->temp_in_fahr.exponent << 24) & 0xFF000000) |
                       ((p_hts_meas->temp_in_fahr.mantissa <<  0) & 0x00FFFFFF);
    }
    else
    {
        encoded_temp = ((p_hts_meas->temp_in_celcius.exponent << 24) & 0xFF000000) |
                       ((p_hts_meas->temp_in_celcius.mantissa <<  0) & 0x00FFFFFF);
    }
    len += uint32_encode(encoded_temp, &p_encoded_buffer[len]);
    /**(uint32_t*)&p_encoded_buffer[len] = encoded_temp;
    len += 4;*/

    // Time Stamp field
    if (p_hts_meas->time_stamp_present)
    {
        flags |= HTS_MEAS_FLAG_TIME_STAMP_BIT;
        len   += ble_date_time_encode(&p_hts_meas->time_stamp, &p_encoded_buffer[len]);
    }

    // Temperature Type field
    if (p_hts_meas->temp_type_present)
    {
        flags                  |= HTS_MEAS_FLAG_TEMP_TYPE_BIT;
        p_encoded_buffer[len++] = p_hts_meas->temp_type;
    }

    // Flags field
    p_encoded_buffer[0] = flags;

    return len;
}
#endif

void htp_init(u8_t blsc)
{
	dev = device_get_binding("MAX30205");

	if (dev == NULL) {
		printk("Could not get MAX30205 device\n");
		return;
	}

	htp_blsc = blsc;

	bt_gatt_service_register(&htp_svc);
}

void htp_notify(void)
{
	/*uint8_t encoded_hts_meas[MAX_HTM_LEN];
    uint16_t len;*/
    ble_hts_meas_t simulated_meas;
    int ret;

    ret = hts_sim_measurement(&simulated_meas);

    /* Heartrate measurements simulation */
	if (!simulate_hrm) {
		return;
	}
    if(ret < 0)
    {
        return;
    }
    //hts_sim_measurement(&simulated_meas);
    //len = hts_measurement_encode(&simulated_meas, encoded_hts_meas);

#if 0
	hrm[0] = 0xf8; /* uint8, sensor contact */
	hrm[1] = tempinc.btemperature[3];
	hrm[2] = tempinc.btemperature[2];
	hrm[3] = tempinc.btemperature[1];
	hrm[4] = tempinc.btemperature[0];
#endif
	bt_gatt_notify(NULL, &attrs[1], &celciusX100, sizeof(celciusX100));
}
```

## src/htp.h
```c
/** @file
 *  @brief HRS Service sample
 */

/*
 * Copyright (c) 2016 Intel Corporation
 *
 * SPDX-License-Identifier: Apache-2.0
 */

#ifdef __cplusplus
extern "C" {
#endif

void htp_init(u8_t blsc);
void htp_notify(void);

#ifdef __cplusplus
}
#endif
```

## src/led.c
```c
/*
 * Copyright (c) 2017 Linaro Limited
 *
 * SPDX-License-Identifier: Apache-2.0
 */

#include <zephyr.h>
#include <device.h>
#include <gpio.h>
#include <misc/printk.h>
#include <misc/__assert.h>
#include <board.h>
#include <string.h>

/* size of stack area used by each thread */
#define STACKSIZE 1024

/* scheduling priority used by each thread */
#define PRIORITY 7

/* Change this if you have an LED connected to a custom port */
#ifndef LED0_GPIO_CONTROLLER
#define LED0_GPIO_CONTROLLER 	LED0_GPIO_PORT
#endif
#ifndef LED1_GPIO_CONTROLLER
#define LED1_GPIO_CONTROLLER 	LED1_GPIO_PORT
#endif
#ifndef LED2_GPIO_CONTROLLER
#define LED2_GPIO_CONTROLLER 	LED2_GPIO_PORT
#endif

#define PORT0	 LED0_GPIO_CONTROLLER
#define PORT1	 LED1_GPIO_CONTROLLER
#define PORT2	 LED2_GPIO_CONTROLLER


/* Change this if you have an LED connected to a custom pin */
#define LED0    LED0_GPIO_PIN
#define LED1    LED1_GPIO_PIN
#define LED2    LED2_GPIO_PIN

struct printk_data_t {
	void *fifo_reserved; /* 1st word reserved for use by fifo */
	u32_t led;
	u32_t cnt;
};
bool bt_connect_flag = false;
bool gps_work_flag = false;
bool ecg_lead_flag = false;

K_FIFO_DEFINE(printk_fifo);

void blink(const char *port, u32_t sleep_ms, u32_t led, u32_t id)
{
	int cnt = 0;
	struct device *gpio_dev;

	gpio_dev = device_get_binding(port);
	__ASSERT_NO_MSG(gpio_dev != NULL);

	gpio_pin_configure(gpio_dev, led, GPIO_DIR_OUT);

	while (1) {
		gpio_pin_write(gpio_dev, led, cnt % 2);
		if(cnt % 2)
		{
			k_sleep(100);
		}
		else
		{
			if(((bt_connect_flag) && (led == LED0)) || ((gps_work_flag) && (led == LED1)) || ((ecg_lead_flag) && (led == LED2)))
			{
				k_sleep(sleep_ms * 2);
			}
			else
			{
				k_sleep(sleep_ms);
			}
		}
		cnt++;
	}
}

void blink1(void)
{
	blink(PORT0, 1000, LED0, 0);
}

void blink2(void)
{
	blink(PORT1, 1000, LED1, 1);
}

void blink3(void)
{
	blink(PORT2, 1000, LED2, 2);
}

K_THREAD_DEFINE(blink1_id, STACKSIZE, blink1, NULL, NULL, NULL,
		PRIORITY, 0, K_NO_WAIT);
K_THREAD_DEFINE(blink2_id, STACKSIZE, blink2, NULL, NULL, NULL,
		PRIORITY, 0, K_NO_WAIT);
K_THREAD_DEFINE(blink3_id, STACKSIZE, blink3, NULL, NULL, NULL,
		PRIORITY, 0, K_NO_WAIT);
```
